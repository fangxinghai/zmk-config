## config/boards/shields/custom_macropad/Kconfig.defconfig
```kconfig
if SHIELD_CUSTOM_MACROPAD

config ZMK_KEYBOARD_NAME
    default "ARC-6"

config ZMK_USB
    default y

config ZMK_BLE
    default y

config ZMK_RGB_UNDERGLOW
    default y

config ZMK_STATUS_LED
    default y

endif
```

## config/boards/shields/custom_macropad/Kconfig.shield
```kconfig
config SHIELD_CUSTOM_MACROPAD
    def_bool $(shields_list_contains,custom_macropad)
```

## config/west.yml
```yaml
manifest:
  remotes:
    - name: zmkfirmware
      url-base: https://github.com/zmkfirmware
    - name: sekigon-gonnoc
      url-base: https://github.com/sekigon-gonnoc
  projects:
    - name: zmk
      remote: zmkfirmware
      revision: main
      import: app/west.yml
    - name: zmk-feature-status-led
      remote: sekigon-gonnoc
      revision: main
  self:
    path: config
```
